## config/west.yml
```yaml
manifest:
  remotes:
    - name: zmkfirmware
      url-base: https://github.com/zmkfirmware
  projects:
    - name: zmk
      remote: zmkfirmware
      revision: v0.3
      import: app/west.yml

    # ZMK modules
    # - name: zmk-tri-state
    #   path: modules/zmk/tri-state
  self:
    path: config
```
