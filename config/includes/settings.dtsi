
// Layer Tap Settings

&lt {  // layer-tap config
    flavor = "balanced";
    tapping-term-ms = <200>;
    quick-tap-ms = <175>;
};

/ {
    chosen {
        zmk,physical-layout = &foostan_corne_5col_layout;
        // zmk,matrix_transform = &default_transform;
        // zmk,matrix_transform = &five_column_transform;
    };
};
